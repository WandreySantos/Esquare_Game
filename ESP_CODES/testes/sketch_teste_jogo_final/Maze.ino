 CRGB playerColor = CRGB(220,120,0); 
const CRGB* chosen;

#define BRANCO CRGB(255,255,255)
#define PRETO CRGB(0,0,0)
#define VERMELHO CRGB(255,0,0)
#define ROXO CRGB(142,24,153)
#define AZUL CRGB(0,0,255)
#define VERDE_FORTE CRGB(0,255,50)
#define ROSA CRGB(255, 20, 147)
#define VERDE CRGB(0, 200, 50)
#define CINZA CRGB(120, 120, 120)

const CRGB maze1[16*16] = {
  BRANCO, BRANCO, BRANCO, BRANCO, BRANCO, BRANCO, BRANCO, CINZA, BRANCO, BRANCO, BRANCO, BRANCO, BRANCO, BRANCO, BRANCO, BRANCO,
  BRANCO, PRETO, PRETO, PRETO, PRETO, AZUL, PRETO, PRETO, PRETO, AZUL, PRETO, PRETO, PRETO, PRETO, PRETO, BRANCO,
  BRANCO, PRETO, AZUL, AZUL, PRETO, AZUL, PRETO, AZUL, PRETO, PRETO, PRETO, AZUL, AZUL, AZUL, PRETO, BRANCO,
  BRANCO, PRETO, PRETO, AZUL, PRETO, PRETO, PRETO, AZUL, AZUL, AZUL, AZUL, PRETO, PRETO, AZUL, PRETO, BRANCO,
  BRANCO, AZUL, PRETO, PRETO, AZUL, AZUL, PRETO, AZUL, PRETO, PRETO, AZUL, PRETO, AZUL, PRETO, PRETO, BRANCO,
  BRANCO, PRETO, AZUL, PRETO, PRETO, AZUL, PRETO, PRETO, PRETO, PRETO, AZUL, PRETO, PRETO, PRETO, AZUL, BRANCO,
  BRANCO, PRETO, AZUL, AZUL, PRETO, AZUL, AZUL, AZUL, AZUL, PRETO, AZUL, AZUL, AZUL, PRETO, AZUL, BRANCO,
  BRANCO, PRETO, PRETO, PRETO, PRETO, AZUL, PRETO, PRETO, PRETO, PRETO, AZUL, PRETO, PRETO, PRETO, AZUL, BRANCO,
  BRANCO, AZUL, AZUL, PRETO, AZUL, AZUL, PRETO, AZUL, AZUL, PRETO, AZUL, PRETO, AZUL, AZUL, AZUL, BRANCO,
  BRANCO, PRETO, PRETO, PRETO, PRETO, PRETO, AZUL, AZUL, PRETO, AZUL, PRETO, PRETO, PRETO, AZUL, PRETO, BRANCO,
  BRANCO, PRETO, AZUL, PRETO, PRETO, AZUL, PRETO, PRETO, PRETO, AZUL, PRETO, AZUL, PRETO, AZUL, PRETO, BRANCO,
  BRANCO, PRETO, AZUL, PRETO, AZUL, AZUL, AZUL, AZUL, PRETO, PRETO, PRETO, AZUL, PRETO, PRETO, PRETO, BRANCO,
  BRANCO, AZUL, AZUL, PRETO, PRETO, AZUL, PRETO, PRETO, PRETO, AZUL, AZUL, AZUL, AZUL, PRETO, PRETO, BRANCO,
  BRANCO, PRETO, AZUL, AZUL, PRETO, PRETO, PRETO, AZUL, AZUL, AZUL, PRETO, PRETO, PRETO, AZUL, PRETO, BRANCO,
  BRANCO, PRETO, PRETO, PRETO, PRETO, AZUL, PRETO, AZUL, PRETO, PRETO, PRETO, AZUL, PRETO, PRETO, PRETO, BRANCO,
  BRANCO, BRANCO, BRANCO, BRANCO, BRANCO, BRANCO, BRANCO, BRANCO, VERDE, BRANCO, BRANCO, BRANCO, BRANCO, BRANCO, BRANCO, BRANCO
};
const CRGB maze2[16*16] = {
  BRANCO, BRANCO, BRANCO, BRANCO, BRANCO, BRANCO, BRANCO, CINZA, BRANCO, BRANCO, BRANCO, BRANCO, BRANCO, BRANCO, BRANCO, BRANCO,
  BRANCO, PRETO, PRETO, PRETO, AZUL, PRETO, PRETO, PRETO, PRETO, PRETO, PRETO, AZUL, PRETO, PRETO, PRETO, BRANCO,
  BRANCO, PRETO, AZUL, PRETO, AZUL, PRETO, AZUL, AZUL, AZUL, AZUL, PRETO, AZUL, PRETO, AZUL, PRETO, BRANCO,
  BRANCO, PRETO, AZUL, PRETO, AZUL, PRETO, PRETO, AZUL, PRETO, PRETO, PRETO, AZUL, PRETO, AZUL, PRETO, BRANCO,
  BRANCO, PRETO, AZUL, PRETO, PRETO, PRETO, PRETO, AZUL, PRETO, AZUL, AZUL, AZUL, PRETO, AZUL, PRETO, BRANCO,
  BRANCO, PRETO, AZUL, AZUL, AZUL, AZUL, AZUL, AZUL, PRETO, PRETO, PRETO, PRETO, PRETO, AZUL, PRETO, BRANCO,
  BRANCO, PRETO, AZUL, PRETO, PRETO, PRETO, PRETO, AZUL, AZUL, PRETO, AZUL, AZUL, AZUL, AZUL, PRETO, BRANCO,
  BRANCO, PRETO, PRETO, PRETO, AZUL, AZUL, PRETO, AZUL, PRETO, PRETO, AZUL, AZUL, AZUL, PRETO, PRETO, BRANCO,
  BRANCO, AZUL, AZUL, AZUL, PRETO, PRETO, PRETO, PRETO, AZUL, PRETO, PRETO, PRETO, AZUL, PRETO, AZUL, BRANCO,
  BRANCO, PRETO, PRETO, PRETO, PRETO, AZUL, AZUL, PRETO, AZUL, AZUL, AZUL, PRETO, AZUL, PRETO, PRETO, BRANCO,
  BRANCO, PRETO, AZUL, AZUL, AZUL, AZUL, PRETO, AZUL, PRETO, AZUL, PRETO, PRETO, PRETO, AZUL, PRETO, BRANCO,
  BRANCO, PRETO, PRETO, AZUL, PRETO, PRETO, PRETO, AZUL, PRETO, AZUL, AZUL, AZUL, AZUL, AZUL, PRETO, BRANCO,
  BRANCO, PRETO, AZUL, PRETO, PRETO, AZUL, PRETO, AZUL, PRETO, PRETO, PRETO, PRETO, PRETO, AZUL, PRETO, BRANCO,
  BRANCO, PRETO, AZUL, PRETO, AZUL, PRETO, PRETO, AZUL, AZUL, AZUL, AZUL, PRETO, AZUL, AZUL, PRETO, BRANCO,
  BRANCO, PRETO, PRETO, PRETO, PRETO, PRETO, PRETO, PRETO, PRETO, PRETO, AZUL, PRETO, PRETO, PRETO, PRETO, BRANCO,
  BRANCO, BRANCO, BRANCO, BRANCO, BRANCO, BRANCO, BRANCO, BRANCO, VERDE, BRANCO, BRANCO, BRANCO, BRANCO, BRANCO, BRANCO, BRANCO
};
const CRGB maze3[16*16] = {
  BRANCO, BRANCO, BRANCO, BRANCO, BRANCO, BRANCO, BRANCO, CINZA, BRANCO, BRANCO, BRANCO, BRANCO, BRANCO, BRANCO, BRANCO, BRANCO,
  BRANCO, PRETO, PRETO, PRETO, PRETO, VERDE_FORTE, PRETO, PRETO, PRETO, VERDE_FORTE, PRETO, PRETO, PRETO, PRETO, PRETO, BRANCO,
  BRANCO, PRETO, VERDE_FORTE, VERDE_FORTE, PRETO, PRETO, PRETO, VERDE_FORTE, PRETO, PRETO, PRETO, VERDE_FORTE, VERDE_FORTE, VERDE_FORTE, PRETO, BRANCO,
  BRANCO, PRETO, PRETO, VERDE_FORTE, PRETO, VERDE_FORTE, VERDE_FORTE, VERDE_FORTE, VERDE_FORTE, VERDE_FORTE, VERDE_FORTE, VERDE_FORTE, PRETO, PRETO, PRETO, BRANCO,
  BRANCO, VERDE_FORTE, PRETO, VERDE_FORTE, PRETO, VERDE_FORTE, PRETO, PRETO, PRETO, VERDE_FORTE, PRETO, VERDE_FORTE, PRETO, VERDE_FORTE, VERDE_FORTE, BRANCO,
  BRANCO, VERDE_FORTE, PRETO, VERDE_FORTE, VERDE_FORTE, PRETO, PRETO, VERDE_FORTE, PRETO, PRETO, PRETO, VERDE_FORTE, PRETO, PRETO, PRETO, BRANCO,
  BRANCO, VERDE_FORTE, PRETO, VERDE_FORTE, PRETO, PRETO, VERDE_FORTE, VERDE_FORTE, VERDE_FORTE, VERDE_FORTE, PRETO, PRETO, PRETO, VERDE_FORTE, PRETO, BRANCO,
  BRANCO, VERDE_FORTE, PRETO, PRETO, PRETO, VERDE_FORTE, PRETO, PRETO, PRETO, VERDE_FORTE, PRETO, VERDE_FORTE, VERDE_FORTE, VERDE_FORTE, PRETO, BRANCO,
  BRANCO, VERDE_FORTE, VERDE_FORTE, VERDE_FORTE, PRETO, VERDE_FORTE, PRETO, VERDE_FORTE, PRETO, PRETO, PRETO, VERDE_FORTE, PRETO, PRETO, PRETO, BRANCO,
  BRANCO, PRETO, VERDE_FORTE, PRETO, PRETO, VERDE_FORTE, PRETO, VERDE_FORTE, PRETO, VERDE_FORTE, VERDE_FORTE, VERDE_FORTE, PRETO, VERDE_FORTE, VERDE_FORTE, BRANCO,
  BRANCO, PRETO, VERDE_FORTE, PRETO, VERDE_FORTE, PRETO, PRETO, VERDE_FORTE, PRETO, VERDE_FORTE, PRETO, PRETO, PRETO, PRETO, PRETO, BRANCO,
  BRANCO, PRETO, VERDE_FORTE, PRETO, VERDE_FORTE, PRETO, VERDE_FORTE, VERDE_FORTE, VERDE_FORTE, VERDE_FORTE, VERDE_FORTE, VERDE_FORTE, PRETO, VERDE_FORTE, PRETO, BRANCO,
  BRANCO, PRETO, PRETO, PRETO, VERDE_FORTE, PRETO, PRETO, VERDE_FORTE, PRETO, PRETO, PRETO, VERDE_FORTE, PRETO, VERDE_FORTE, PRETO, BRANCO,
  BRANCO, PRETO, VERDE_FORTE, VERDE_FORTE, PRETO, VERDE_FORTE, PRETO, VERDE_FORTE, PRETO, VERDE_FORTE, PRETO, VERDE_FORTE, VERDE_FORTE, VERDE_FORTE, PRETO, BRANCO,
  BRANCO, PRETO, PRETO, PRETO, PRETO, VERDE_FORTE, PRETO, PRETO, PRETO, VERDE_FORTE, PRETO, PRETO, PRETO, PRETO, PRETO, BRANCO,
  BRANCO, BRANCO, BRANCO, BRANCO, BRANCO, BRANCO, BRANCO, BRANCO, VERDE, BRANCO, BRANCO, BRANCO, BRANCO, BRANCO, BRANCO, BRANCO,
};
const CRGB maze4[16*16] = {
  BRANCO, BRANCO, BRANCO, CINZA, BRANCO, BRANCO, BRANCO, BRANCO, BRANCO, BRANCO, BRANCO, BRANCO, BRANCO, VERDE, BRANCO, BRANCO,
  BRANCO, PRETO, PRETO, PRETO, PRETO, ROXO, ROXO, PRETO, PRETO, PRETO, PRETO, ROXO, PRETO, PRETO, PRETO, BRANCO,
  BRANCO, PRETO, ROXO, ROXO, PRETO, PRETO, ROXO, PRETO, ROXO, ROXO, PRETO, PRETO, PRETO, ROXO, PRETO, BRANCO,
  BRANCO, PRETO, PRETO, ROXO, ROXO, PRETO, ROXO, PRETO, PRETO, PRETO, ROXO, ROXO, ROXO, PRETO, PRETO, BRANCO,
  BRANCO, ROXO, PRETO, ROXO, PRETO, PRETO, PRETO, ROXO, ROXO, PRETO, PRETO, PRETO, ROXO, PRETO, ROXO, BRANCO,
  BRANCO, ROXO, PRETO, ROXO, ROXO, ROXO, PRETO, PRETO, ROXO, ROXO, ROXO, PRETO, ROXO, PRETO, ROXO, BRANCO,
  BRANCO, ROXO, PRETO, PRETO, PRETO, PRETO, ROXO, PRETO, ROXO, ROXO, PRETO, PRETO, ROXO, PRETO, ROXO, BRANCO,
  BRANCO, ROXO, ROXO, PRETO, ROXO, ROXO, ROXO, PRETO, ROXO, ROXO, PRETO, ROXO, ROXO, PRETO, ROXO, BRANCO,
  BRANCO, PRETO, PRETO, PRETO, ROXO, PRETO, PRETO, PRETO, PRETO, ROXO, PRETO, PRETO, ROXO, PRETO, PRETO, BRANCO,
  BRANCO, PRETO, ROXO, PRETO, ROXO, PRETO, ROXO, ROXO, PRETO, PRETO, ROXO, PRETO, ROXO, ROXO, PRETO, BRANCO,
  BRANCO, PRETO, ROXO, PRETO, ROXO, PRETO, PRETO, ROXO, ROXO, PRETO, ROXO, PRETO, PRETO, PRETO, PRETO, BRANCO,
  BRANCO, PRETO, ROXO, ROXO, ROXO, ROXO, PRETO, PRETO, ROXO, PRETO, ROXO, PRETO, ROXO, PRETO, ROXO, BRANCO,
  BRANCO, PRETO, PRETO, PRETO, PRETO, ROXO, ROXO, ROXO, ROXO, ROXO, ROXO, PRETO, ROXO, PRETO, PRETO, BRANCO,
  BRANCO, ROXO, PRETO, ROXO, ROXO, PRETO, PRETO, PRETO, ROXO, PRETO, PRETO, PRETO, ROXO, ROXO, PRETO, BRANCO,
  BRANCO, ROXO, PRETO, PRETO, PRETO, PRETO, ROXO, PRETO, PRETO, PRETO, ROXO, PRETO, PRETO, PRETO, PRETO, BRANCO,
  BRANCO, BRANCO, BRANCO, BRANCO, BRANCO, BRANCO, BRANCO, BRANCO, BRANCO, BRANCO, BRANCO, BRANCO, BRANCO, BRANCO, BRANCO, BRANCO,
};
const CRGB maze5[16*16] = {
  BRANCO,BRANCO,BRANCO,BRANCO,BRANCO,BRANCO,BRANCO,BRANCO,BRANCO,BRANCO,BRANCO,BRANCO,BRANCO,BRANCO,BRANCO,BRANCO,
  BRANCO,VERMELHO,VERMELHO,PRETO,PRETO,PRETO,VERMELHO,PRETO,PRETO,PRETO,PRETO,PRETO,PRETO,PRETO,PRETO,BRANCO,
  BRANCO,VERMELHO,PRETO,PRETO,VERMELHO,PRETO,PRETO,PRETO,VERMELHO,VERMELHO,PRETO,VERMELHO,VERMELHO,VERMELHO,PRETO,BRANCO,
  BRANCO,PRETO,PRETO,VERMELHO,VERMELHO,VERMELHO,PRETO,VERMELHO,VERMELHO,PRETO,PRETO,PRETO,PRETO,VERMELHO,PRETO,BRANCO,
  CINZA,PRETO,VERMELHO,VERMELHO,PRETO,VERMELHO,PRETO,VERMELHO,PRETO,PRETO,PRETO,VERMELHO,PRETO,VERMELHO,PRETO,BRANCO,
  BRANCO,PRETO,PRETO,PRETO,PRETO,VERMELHO,PRETO,VERMELHO,PRETO,VERMELHO,PRETO,VERMELHO,PRETO,VERMELHO,PRETO,BRANCO,
  BRANCO,VERMELHO,PRETO,VERMELHO,PRETO,VERMELHO,PRETO,PRETO,VERMELHO,VERMELHO,PRETO,VERMELHO,PRETO,PRETO,PRETO,BRANCO,
  BRANCO,PRETO,PRETO,VERMELHO,VERMELHO,VERMELHO,PRETO,VERMELHO,VERMELHO,PRETO,VERMELHO,PRETO,PRETO,VERMELHO,PRETO,BRANCO,
  BRANCO,PRETO,VERMELHO,VERMELHO,PRETO,VERMELHO,PRETO,PRETO,VERMELHO,PRETO,PRETO,PRETO,PRETO,VERMELHO,PRETO,BRANCO,
  BRANCO,PRETO,PRETO,VERMELHO,PRETO,VERMELHO,VERMELHO,PRETO,VERMELHO,PRETO,VERMELHO,VERMELHO,VERMELHO,VERMELHO,PRETO,BRANCO,
  BRANCO,VERMELHO,PRETO,VERMELHO,PRETO,PRETO,PRETO,PRETO,PRETO,PRETO,VERMELHO,PRETO,PRETO,VERMELHO,PRETO,BRANCO,
  BRANCO,VERMELHO,PRETO,VERMELHO,PRETO,PRETO,VERMELHO,PRETO,VERMELHO,VERMELHO,VERMELHO,PRETO,VERMELHO,VERMELHO,PRETO,BRANCO,
  BRANCO,VERMELHO,PRETO,PRETO,PRETO,VERMELHO,VERMELHO,VERMELHO,PRETO,PRETO,PRETO,PRETO,PRETO,PRETO,PRETO,BRANCO,
  BRANCO,PRETO,PRETO,VERMELHO,PRETO,PRETO,PRETO,VERMELHO,VERMELHO,VERMELHO,PRETO,VERMELHO,VERMELHO,VERMELHO,PRETO,BRANCO,
  BRANCO,PRETO,VERMELHO,VERMELHO,VERMELHO,VERMELHO,PRETO,VERMELHO,PRETO,PRETO,PRETO,PRETO,VERMELHO,PRETO,PRETO,BRANCO,
  BRANCO,BRANCO,BRANCO,BRANCO,BRANCO,BRANCO,BRANCO,BRANCO,BRANCO,BRANCO,VERDE,BRANCO,BRANCO,BRANCO,BRANCO,BRANCO
};
const CRGB maze6[16*16] = {
  BRANCO, BRANCO, BRANCO, BRANCO, BRANCO, BRANCO, BRANCO, BRANCO, BRANCO, CINZA, BRANCO, BRANCO, BRANCO, BRANCO, BRANCO, BRANCO,
  BRANCO, PRETO, PRETO, PRETO, PRETO, ROSA, PRETO, PRETO, PRETO, PRETO, ROSA, PRETO, PRETO, PRETO, ROSA, BRANCO,
  BRANCO, PRETO, ROSA, ROSA, PRETO, PRETO, PRETO, ROSA, ROSA, PRETO, PRETO, PRETO, ROSA, PRETO, PRETO, BRANCO,
  BRANCO, PRETO, PRETO, PRETO, ROSA, ROSA, ROSA, PRETO, PRETO, PRETO, ROSA, ROSA, ROSA, ROSA, PRETO, BRANCO,     
  BRANCO, PRETO, ROSA, PRETO, PRETO, PRETO, ROSA, PRETO, ROSA, ROSA, PRETO, PRETO, PRETO, ROSA, PRETO, BRANCO,
  BRANCO, PRETO, ROSA, ROSA, ROSA, PRETO, ROSA, PRETO, PRETO, PRETO, PRETO, ROSA, PRETO, PRETO, PRETO, BRANCO,
  BRANCO, PRETO, PRETO, PRETO, PRETO, PRETO, PRETO, ROSA, ROSA, PRETO, ROSA, ROSA, ROSA, ROSA, ROSA, BRANCO,     
  BRANCO, ROSA, ROSA, PRETO, ROSA, PRETO, ROSA, PRETO, ROSA, PRETO, PRETO, PRETO, PRETO, PRETO, ROSA, BRANCO,
  BRANCO, PRETO, PRETO, PRETO, ROSA, PRETO, ROSA, PRETO, PRETO, ROSA, ROSA, ROSA, ROSA, PRETO, ROSA, BRANCO,     
  BRANCO, PRETO, ROSA, ROSA, ROSA, PRETO, ROSA, PRETO, PRETO, ROSA, PRETO, PRETO, PRETO, PRETO, PRETO, BRANCO,
  BRANCO, PRETO, ROSA, PRETO, PRETO, PRETO, ROSA, ROSA, PRETO, PRETO, PRETO, ROSA, PRETO, ROSA, ROSA, BRANCO,
  BRANCO, PRETO, PRETO, PRETO, ROSA, PRETO, PRETO, PRETO, ROSA, ROSA, ROSA, ROSA, PRETO, PRETO, ROSA, BRANCO,
  BRANCO, ROSA, PRETO, ROSA, ROSA, PRETO, ROSA, PRETO, ROSA, PRETO, PRETO, PRETO, ROSA, PRETO, PRETO, BRANCO,
  BRANCO, ROSA, PRETO, PRETO, ROSA, PRETO, ROSA, PRETO, ROSA, PRETO, ROSA, PRETO, ROSA, ROSA, PRETO, BRANCO,     
  BRANCO, ROSA, ROSA, PRETO, PRETO, PRETO, PRETO, PRETO, PRETO, PRETO, ROSA, PRETO, PRETO, PRETO, PRETO, VERDE,
  BRANCO, BRANCO, BRANCO, BRANCO, BRANCO, BRANCO, BRANCO, BRANCO, BRANCO, BRANCO, BRANCO, BRANCO, BRANCO, BRANCO, BRANCO, BRANCO,
};


void drawPlayer() {
  leds[xy(playerX, playerY)] = playerColor;
}
bool isWall(int x, int y) {
  CRGB c = chosen[y * 16 + x];
  if(c == PRETO){
    return true;
  }
  else if(c == VERDE){
    mazeFinished = true;
    mazeRunning = false;
    return true;
  }
  return false;
}

void findStartPosition() {
  for (int y = 0; y < 16; y++) {
    for (int x = 0; x < 16; x++) {
      CRGB c = chosen[y * 16 + x];

      if (c == CINZA) {
        playerX = x;
        playerY = y;
        return; // achou e sai da função
      }
    }
  }
}

void drawMaze() {
  // desenha o mapa base
  for (int y = 0; y < 16; y++) {
    for (int x = 0; x < 16; x++) {
      leds[xy(x, y)] = chosen[y * 16 + x];
    }
  }

  // desenha o jogador por cima
  leds[xy(playerX, playerY)] = playerColor;

  FastLED.show();
}

void loadRandomMaze() {
  int r = random(1, 7);  // sorteia 1,2,3   (aumente se tiver mais)
  if (r == 1) chosen = maze1; 
    else if (r == 2) chosen = maze2;
    else if (r == 3) chosen = maze3;
    else if (r == 4) chosen = maze4;
    else if (r == 5) chosen = maze5;
    else if (r == 6) chosen = maze6;
}

void startMaze() {
  // Entrou no jogo agora
  if (!mazeRunning) {
    loadRandomMaze();
    findStartPosition();
    drawMaze();

    mazeRunning = true;
    Serial.println("Maze iniciado");
  }
  // Durante o jogo
  if (mazeRunning && !mazeFinished) {
    drawMaze();
  }
  // fim de jogo
  if (mazeFinished) {
    Serial.println("Maze finalizado");
    delay(1000);
    mazeFinished = false;
  }
}
