#include <FastLED.h>

// PRIEMIRA  MANETE
#define PIN_X 34
#define PIN_Y 35
#define PIN_SW 14

int eixoX = 0;
int eixoY = 0;
int botao = HIGH;
int botaoAnterior = HIGH;
bool botaoClique = false;
unsigned long tempoPressionado = 0;

int centerX = 2000;
int centerY = 2000;
int deadzone = 200;

String directionJoy = "";
String lastDirectionJoy = "";
String lastMove = "center";

void lerJoystick() {
  eixoX = analogRead(PIN_X);
  eixoY = analogRead(PIN_Y);

  botaoAnterior = botao;           
  botao = digitalRead(PIN_SW);     
  botaoClique = (botaoAnterior == HIGH && botao == LOW);
}

void atualizarDirecaoJoystick() {
  String original = "center";

  if (eixoX < centerX - deadzone) original = "left";
  else if (eixoX > centerX + deadzone) original = "right";
  if (eixoY < centerY - deadzone) original = "down";
  else if (eixoY > centerY + deadzone) original = "up";

  // mapeamento invertido 90° CW
  if (original == "up") directionJoy = "left";
  else if (original == "right") directionJoy = "down";
  else if (original == "down") directionJoy = "right";
  else if (original == "left") directionJoy = "up";
  else directionJoy = "center";

  if (directionJoy != lastDirectionJoy) {
    Serial.println(directionJoy);
    lastDirectionJoy = directionJoy;
  }
}
void atualizarCursor() {
  if (directionJoy == "center") { lastMove = "center"; return; }
  if (lastMove != "center") return;
  lastMove = directionJoy;
}

#define LED_PIN 25
#define MATRIX_WIDTH 16
#define MATRIX_HEIGHT 16
#define NUM_LEDS (MATRIX_WIDTH * MATRIX_HEIGHT)

CRGB leds[NUM_LEDS];

// --- Definição das cores ---
#define BRANCO CRGB(255,255,255)
#define PRETO CRGB(0,0,0)
#define VERMELHO CRGB(255,0,0)
#define ROXO CRGB(142,24,153)
#define AZUL CRGB(0,0,255)
#define VERDE_FORTE CRGB(0,255,50)
#define ROSA CRGB(255, 20, 147)
#define VERDE CRGB(0, 200, 50)

// --- MAPEAMENTO SERPENTINA ---
int xy(int x, int y) {
  if (y % 2 == 0) return (y * MATRIX_WIDTH + x);
  else return (y * MATRIX_WIDTH + (MATRIX_WIDTH - 1 - x));
}

const CRGB maze1[16*16] = {
  BRANCO, BRANCO, BRANCO, BRANCO, BRANCO, BRANCO, BRANCO, PRETO, BRANCO, BRANCO, BRANCO, BRANCO, BRANCO, BRANCO, BRANCO, BRANCO,
  BRANCO, PRETO, PRETO, PRETO, PRETO, AZUL, PRETO, PRETO, PRETO, AZUL, PRETO, PRETO, PRETO, PRETO, PRETO, BRANCO,
  BRANCO, PRETO, AZUL, AZUL, PRETO, AZUL, PRETO, AZUL, PRETO, PRETO, PRETO, AZUL, AZUL, AZUL, PRETO, BRANCO,
  BRANCO, PRETO, PRETO, AZUL, PRETO, PRETO, PRETO, AZUL, AZUL, AZUL, AZUL, PRETO, PRETO, AZUL, PRETO, BRANCO,
  BRANCO, AZUL, PRETO, PRETO, AZUL, AZUL, PRETO, AZUL, PRETO, PRETO, AZUL, PRETO, AZUL, PRETO, PRETO, BRANCO,
  BRANCO, PRETO, AZUL, PRETO, PRETO, AZUL, PRETO, PRETO, PRETO, PRETO, AZUL, PRETO, PRETO, PRETO, AZUL, BRANCO,
  BRANCO, PRETO, AZUL, AZUL, PRETO, AZUL, AZUL, AZUL, AZUL, PRETO, AZUL, AZUL, AZUL, PRETO, AZUL, BRANCO,
  BRANCO, PRETO, PRETO, PRETO, PRETO, AZUL, PRETO, PRETO, PRETO, PRETO, AZUL, PRETO, PRETO, PRETO, AZUL, BRANCO,
  BRANCO, AZUL, AZUL, PRETO, AZUL, AZUL, PRETO, AZUL, AZUL, PRETO, AZUL, PRETO, AZUL, AZUL, AZUL, BRANCO,
  BRANCO, PRETO, PRETO, PRETO, PRETO, PRETO, AZUL, AZUL, PRETO, AZUL, PRETO, PRETO, PRETO, AZUL, PRETO, BRANCO,
  BRANCO, PRETO, AZUL, PRETO, PRETO, AZUL, PRETO, PRETO, PRETO, AZUL, PRETO, AZUL, PRETO, AZUL, PRETO, BRANCO,
  BRANCO, PRETO, AZUL, PRETO, AZUL, AZUL, AZUL, AZUL, PRETO, PRETO, PRETO, AZUL, PRETO, PRETO, PRETO, BRANCO,
  BRANCO, AZUL, AZUL, PRETO, PRETO, AZUL, PRETO, PRETO, PRETO, AZUL, AZUL, AZUL, AZUL, PRETO, PRETO, BRANCO,
  BRANCO, PRETO, AZUL, AZUL, PRETO, PRETO, PRETO, AZUL, AZUL, AZUL, PRETO, PRETO, PRETO, AZUL, PRETO, BRANCO,
  BRANCO, PRETO, PRETO, PRETO, PRETO, AZUL, PRETO, AZUL, PRETO, PRETO, PRETO, AZUL, PRETO, PRETO, PRETO, BRANCO,
  BRANCO, BRANCO, BRANCO, BRANCO, BRANCO, BRANCO, BRANCO, BRANCO, VERDE, BRANCO, BRANCO, BRANCO, BRANCO, BRANCO, BRANCO, BRANCO
};
const CRGB maze2[16*16] = {
  BRANCO, BRANCO, BRANCO, BRANCO, BRANCO, BRANCO, BRANCO, PRETO, BRANCO, BRANCO, BRANCO, BRANCO, BRANCO, BRANCO, BRANCO, BRANCO,
  BRANCO, PRETO, PRETO, PRETO, AZUL, PRETO, PRETO, PRETO, PRETO, PRETO, PRETO, AZUL, PRETO, PRETO, PRETO, BRANCO,
  BRANCO, PRETO, AZUL, PRETO, AZUL, PRETO, AZUL, AZUL, AZUL, AZUL, PRETO, AZUL, PRETO, AZUL, PRETO, BRANCO,
  BRANCO, PRETO, AZUL, PRETO, AZUL, PRETO, PRETO, AZUL, PRETO, PRETO, PRETO, AZUL, PRETO, AZUL, PRETO, BRANCO,
  BRANCO, PRETO, AZUL, PRETO, PRETO, PRETO, PRETO, AZUL, PRETO, AZUL, AZUL, AZUL, PRETO, AZUL, PRETO, BRANCO,
  BRANCO, PRETO, AZUL, AZUL, AZUL, AZUL, AZUL, AZUL, PRETO, PRETO, PRETO, PRETO, PRETO, AZUL, PRETO, BRANCO,
  BRANCO, PRETO, AZUL, PRETO, PRETO, PRETO, PRETO, AZUL, AZUL, PRETO, AZUL, AZUL, AZUL, AZUL, PRETO, BRANCO,
  BRANCO, PRETO, PRETO, PRETO, AZUL, AZUL, PRETO, AZUL, PRETO, PRETO, AZUL, AZUL, AZUL, PRETO, PRETO, BRANCO,
  BRANCO, AZUL, AZUL, AZUL, PRETO, PRETO, PRETO, PRETO, AZUL, PRETO, PRETO, PRETO, AZUL, PRETO, AZUL, BRANCO,
  BRANCO, PRETO, PRETO, PRETO, PRETO, AZUL, AZUL, PRETO, AZUL, AZUL, AZUL, PRETO, AZUL, PRETO, PRETO, BRANCO,
  BRANCO, PRETO, AZUL, AZUL, AZUL, AZUL, PRETO, AZUL, PRETO, AZUL, PRETO, PRETO, PRETO, AZUL, PRETO, BRANCO,
  BRANCO, PRETO, PRETO, AZUL, PRETO, PRETO, PRETO, AZUL, PRETO, AZUL, AZUL, AZUL, AZUL, AZUL, PRETO, BRANCO,
  BRANCO, PRETO, AZUL, PRETO, PRETO, AZUL, PRETO, AZUL, PRETO, PRETO, PRETO, PRETO, PRETO, AZUL, PRETO, BRANCO,
  BRANCO, PRETO, AZUL, PRETO, AZUL, PRETO, PRETO, AZUL, AZUL, AZUL, AZUL, PRETO, AZUL, AZUL, PRETO, BRANCO,
  BRANCO, PRETO, PRETO, PRETO, PRETO, PRETO, PRETO, PRETO, PRETO, PRETO, AZUL, PRETO, PRETO, PRETO, PRETO, BRANCO,
  BRANCO, BRANCO, BRANCO, BRANCO, BRANCO, BRANCO, BRANCO, BRANCO, VERDE, BRANCO, BRANCO, BRANCO, BRANCO, BRANCO, BRANCO, BRANCO
};
const CRGB maze3[16*16] = {
  BRANCO, BRANCO, BRANCO, BRANCO, BRANCO, BRANCO, BRANCO, PRETO, BRANCO, BRANCO, BRANCO, BRANCO, BRANCO, BRANCO, BRANCO, BRANCO,
  BRANCO, PRETO, PRETO, PRETO, PRETO, VERDE_FORTE, PRETO, PRETO, PRETO, VERDE_FORTE, PRETO, PRETO, PRETO, PRETO, PRETO, BRANCO,
  BRANCO, PRETO, VERDE_FORTE, VERDE_FORTE, PRETO, PRETO, PRETO, VERDE_FORTE, PRETO, PRETO, PRETO, VERDE_FORTE, VERDE_FORTE, VERDE_FORTE, PRETO, BRANCO,
  BRANCO, PRETO, PRETO, VERDE_FORTE, PRETO, VERDE_FORTE, VERDE_FORTE, VERDE_FORTE, VERDE_FORTE, VERDE_FORTE, VERDE_FORTE, VERDE_FORTE, PRETO, PRETO, PRETO, BRANCO,
  BRANCO, VERDE_FORTE, PRETO, VERDE_FORTE, PRETO, VERDE_FORTE, PRETO, PRETO, PRETO, VERDE_FORTE, PRETO, VERDE_FORTE, PRETO, VERDE_FORTE, VERDE_FORTE, BRANCO,
  BRANCO, VERDE_FORTE, PRETO, VERDE_FORTE, VERDE_FORTE, PRETO, PRETO, VERDE_FORTE, PRETO, PRETO, PRETO, VERDE_FORTE, PRETO, PRETO, PRETO, BRANCO,
  BRANCO, VERDE_FORTE, PRETO, VERDE_FORTE, PRETO, PRETO, VERDE_FORTE, VERDE_FORTE, VERDE_FORTE, VERDE_FORTE, PRETO, PRETO, PRETO, VERDE_FORTE, PRETO, BRANCO,
  BRANCO, VERDE_FORTE, PRETO, PRETO, PRETO, VERDE_FORTE, PRETO, PRETO, PRETO, VERDE_FORTE, PRETO, VERDE_FORTE, VERDE_FORTE, VERDE_FORTE, PRETO, BRANCO,
  BRANCO, VERDE_FORTE, VERDE_FORTE, VERDE_FORTE, PRETO, VERDE_FORTE, PRETO, VERDE_FORTE, PRETO, PRETO, PRETO, VERDE_FORTE, PRETO, PRETO, PRETO, BRANCO,
  BRANCO, PRETO, VERDE_FORTE, PRETO, PRETO, VERDE_FORTE, PRETO, VERDE_FORTE, PRETO, VERDE_FORTE, VERDE_FORTE, VERDE_FORTE, PRETO, VERDE_FORTE, VERDE_FORTE, BRANCO,
  BRANCO, PRETO, VERDE_FORTE, PRETO, VERDE_FORTE, PRETO, PRETO, VERDE_FORTE, PRETO, VERDE_FORTE, PRETO, PRETO, PRETO, PRETO, PRETO, BRANCO,
  BRANCO, PRETO, VERDE_FORTE, PRETO, VERDE_FORTE, PRETO, VERDE_FORTE, VERDE_FORTE, VERDE_FORTE, VERDE_FORTE, VERDE_FORTE, VERDE_FORTE, PRETO, VERDE_FORTE, PRETO, BRANCO,
  BRANCO, PRETO, PRETO, PRETO, VERDE_FORTE, PRETO, PRETO, VERDE_FORTE, PRETO, PRETO, PRETO, VERDE_FORTE, PRETO, VERDE_FORTE, PRETO, BRANCO,
  BRANCO, PRETO, VERDE_FORTE, VERDE_FORTE, PRETO, VERDE_FORTE, PRETO, VERDE_FORTE, PRETO, VERDE_FORTE, PRETO, VERDE_FORTE, VERDE_FORTE, VERDE_FORTE, PRETO, BRANCO,
  BRANCO, PRETO, PRETO, PRETO, PRETO, VERDE_FORTE, PRETO, PRETO, PRETO, VERDE_FORTE, PRETO, PRETO, PRETO, PRETO, PRETO, BRANCO,
  BRANCO, BRANCO, BRANCO, BRANCO, BRANCO, BRANCO, BRANCO, BRANCO, VERDE, BRANCO, BRANCO, BRANCO, BRANCO, BRANCO, BRANCO, BRANCO,
};
const CRGB maze4[16*16] = {
  BRANCO, BRANCO, BRANCO, PRETO, BRANCO, BRANCO, BRANCO, BRANCO, BRANCO, BRANCO, BRANCO, BRANCO, BRANCO, VERDE, BRANCO, BRANCO,
  BRANCO, PRETO, PRETO, PRETO, PRETO, ROXO, ROXO, PRETO, PRETO, PRETO, PRETO, ROXO, PRETO, PRETO, PRETO, BRANCO,
  BRANCO, PRETO, ROXO, ROXO, PRETO, PRETO, ROXO, PRETO, ROXO, ROXO, PRETO, PRETO, PRETO, ROXO, PRETO, BRANCO,
  BRANCO, PRETO, PRETO, ROXO, ROXO, PRETO, ROXO, PRETO, PRETO, PRETO, ROXO, ROXO, ROXO, PRETO, PRETO, BRANCO,
  BRANCO, ROXO, PRETO, ROXO, PRETO, PRETO, PRETO, ROXO, ROXO, PRETO, PRETO, PRETO, ROXO, PRETO, ROXO, BRANCO,
  BRANCO, ROXO, PRETO, ROXO, ROXO, ROXO, PRETO, PRETO, ROXO, ROXO, ROXO, PRETO, ROXO, PRETO, ROXO, BRANCO,
  BRANCO, ROXO, PRETO, PRETO, PRETO, PRETO, ROXO, PRETO, ROXO, ROXO, PRETO, PRETO, ROXO, PRETO, ROXO, BRANCO,
  BRANCO, ROXO, ROXO, PRETO, ROXO, ROXO, ROXO, PRETO, ROXO, ROXO, PRETO, ROXO, ROXO, PRETO, ROXO, BRANCO,
  BRANCO, PRETO, PRETO, PRETO, ROXO, PRETO, PRETO, PRETO, PRETO, ROXO, PRETO, PRETO, ROXO, PRETO, PRETO, BRANCO,
  BRANCO, PRETO, ROXO, PRETO, ROXO, PRETO, ROXO, ROXO, PRETO, PRETO, ROXO, PRETO, ROXO, ROXO, PRETO, BRANCO,
  BRANCO, PRETO, ROXO, PRETO, ROXO, PRETO, PRETO, ROXO, ROXO, PRETO, ROXO, PRETO, PRETO, PRETO, PRETO, BRANCO,
  BRANCO, PRETO, ROXO, ROXO, ROXO, ROXO, PRETO, PRETO, ROXO, PRETO, ROXO, PRETO, ROXO, PRETO, ROXO, BRANCO,
  BRANCO, PRETO, PRETO, PRETO, PRETO, ROXO, ROXO, ROXO, ROXO, ROXO, ROXO, PRETO, ROXO, PRETO, PRETO, BRANCO,
  BRANCO, ROXO, PRETO, ROXO, ROXO, PRETO, PRETO, PRETO, ROXO, PRETO, PRETO, PRETO, ROXO, ROXO, PRETO, BRANCO,
  BRANCO, ROXO, PRETO, PRETO, PRETO, PRETO, ROXO, PRETO, PRETO, PRETO, ROXO, PRETO, PRETO, PRETO, PRETO, BRANCO,
  BRANCO, BRANCO, BRANCO, BRANCO, BRANCO, BRANCO, BRANCO, BRANCO, BRANCO, BRANCO, BRANCO, BRANCO, BRANCO, BRANCO, BRANCO, BRANCO,
};

const CRGB maze5[16*16] = {
BRANCO,BRANCO,BRANCO,BRANCO,BRANCO,BRANCO,BRANCO,BRANCO,BRANCO,BRANCO,BRANCO,BRANCO,BRANCO,BRANCO,BRANCO,BRANCO,
BRANCO,VERMELHO,VERMELHO,PRETO,PRETO,PRETO,VERMELHO,PRETO,PRETO,PRETO,PRETO,PRETO,PRETO,PRETO,PRETO,BRANCO,
BRANCO,VERMELHO,PRETO,PRETO,VERMELHO,PRETO,PRETO,PRETO,VERMELHO,VERMELHO,PRETO,VERMELHO,VERMELHO,VERMELHO,PRETO,BRANCO,
BRANCO,PRETO,PRETO,VERMELHO,VERMELHO,VERMELHO,PRETO,VERMELHO,VERMELHO,PRETO,PRETO,PRETO,PRETO,VERMELHO,PRETO,BRANCO,
PRETO,PRETO,VERMELHO,VERMELHO,PRETO,VERMELHO,PRETO,VERMELHO,PRETO,PRETO,PRETO,VERMELHO,PRETO,VERMELHO,PRETO,BRANCO,
BRANCO,PRETO,PRETO,PRETO,PRETO,VERMELHO,PRETO,VERMELHO,PRETO,VERMELHO,PRETO,VERMELHO,PRETO,VERMELHO,PRETO,BRANCO,
BRANCO,VERMELHO,PRETO,VERMELHO,PRETO,VERMELHO,PRETO,PRETO,VERMELHO,VERMELHO,PRETO,VERMELHO,PRETO,PRETO,PRETO,BRANCO,
BRANCO,PRETO,PRETO,VERMELHO,VERMELHO,VERMELHO,PRETO,VERMELHO,VERMELHO,PRETO,VERMELHO,PRETO,PRETO,VERMELHO,PRETO,BRANCO,
BRANCO,PRETO,VERMELHO,VERMELHO,PRETO,VERMELHO,PRETO,PRETO,VERMELHO,PRETO,PRETO,PRETO,PRETO,VERMELHO,PRETO,BRANCO,
BRANCO,PRETO,PRETO,VERMELHO,PRETO,VERMELHO,VERMELHO,PRETO,VERMELHO,PRETO,VERMELHO,VERMELHO,VERMELHO,VERMELHO,PRETO,BRANCO,
BRANCO,VERMELHO,PRETO,VERMELHO,PRETO,PRETO,PRETO,PRETO,PRETO,PRETO,VERMELHO,PRETO,PRETO,VERMELHO,PRETO,BRANCO,
BRANCO,VERMELHO,PRETO,VERMELHO,PRETO,PRETO,VERMELHO,PRETO,VERMELHO,VERMELHO,VERMELHO,PRETO,VERMELHO,VERMELHO,PRETO,BRANCO,
BRANCO,VERMELHO,PRETO,PRETO,PRETO,VERMELHO,VERMELHO,VERMELHO,PRETO,PRETO,PRETO,PRETO,PRETO,PRETO,PRETO,BRANCO,
BRANCO,PRETO,PRETO,VERMELHO,PRETO,PRETO,PRETO,VERMELHO,VERMELHO,VERMELHO,PRETO,VERMELHO,VERMELHO,VERMELHO,PRETO,BRANCO,
BRANCO,PRETO,VERMELHO,VERMELHO,VERMELHO,VERMELHO,PRETO,VERMELHO,PRETO,PRETO,PRETO,PRETO,VERMELHO,PRETO,PRETO,BRANCO,
BRANCO,BRANCO,BRANCO,BRANCO,BRANCO,BRANCO,BRANCO,BRANCO,BRANCO,BRANCO,VERDE,BRANCO,BRANCO,BRANCO,BRANCO,BRANCO
};


const CRGB maze6[16*16] = {
  BRANCO, BRANCO, BRANCO, BRANCO, BRANCO, BRANCO, BRANCO, BRANCO, BRANCO, PRETO, BRANCO, BRANCO, BRANCO, BRANCO, BRANCO, BRANCO,
  BRANCO, PRETO, PRETO, PRETO, PRETO, ROSA, PRETO, PRETO, PRETO, PRETO, ROSA, PRETO, PRETO, PRETO, ROSA, BRANCO,
  BRANCO, PRETO, ROSA, ROSA, PRETO, PRETO, PRETO, ROSA, ROSA, PRETO, PRETO, PRETO, ROSA, PRETO, PRETO, BRANCO,
  BRANCO, PRETO, PRETO, PRETO, ROSA, ROSA, ROSA, PRETO, PRETO, PRETO, ROSA, ROSA, ROSA, ROSA, PRETO, BRANCO,     
  BRANCO, PRETO, ROSA, PRETO, PRETO, PRETO, ROSA, PRETO, ROSA, ROSA, PRETO, PRETO, PRETO, ROSA, PRETO, BRANCO,
  BRANCO, PRETO, ROSA, ROSA, ROSA, PRETO, ROSA, PRETO, PRETO, PRETO, PRETO, ROSA, PRETO, PRETO, PRETO, BRANCO,
  BRANCO, PRETO, PRETO, PRETO, PRETO, PRETO, PRETO, ROSA, ROSA, PRETO, ROSA, ROSA, ROSA, ROSA, ROSA, BRANCO,     
  BRANCO, ROSA, ROSA, PRETO, ROSA, PRETO, ROSA, PRETO, ROSA, PRETO, PRETO, PRETO, PRETO, PRETO, ROSA, BRANCO,
  BRANCO, PRETO, PRETO, PRETO, ROSA, PRETO, ROSA, PRETO, PRETO, ROSA, ROSA, ROSA, ROSA, PRETO, ROSA, BRANCO,     
  BRANCO, PRETO, ROSA, ROSA, ROSA, PRETO, ROSA, PRETO, PRETO, ROSA, PRETO, PRETO, PRETO, PRETO, PRETO, BRANCO,
  BRANCO, PRETO, ROSA, PRETO, PRETO, PRETO, ROSA, ROSA, PRETO, PRETO, PRETO, ROSA, PRETO, ROSA, ROSA, BRANCO,
  BRANCO, PRETO, PRETO, PRETO, ROSA, PRETO, PRETO, PRETO, ROSA, ROSA, ROSA, ROSA, PRETO, PRETO, ROSA, BRANCO,
  BRANCO, ROSA, PRETO, ROSA, ROSA, PRETO, ROSA, PRETO, ROSA, PRETO, PRETO, PRETO, ROSA, PRETO, PRETO, BRANCO,
  BRANCO, ROSA, PRETO, PRETO, ROSA, PRETO, ROSA, PRETO, ROSA, PRETO, ROSA, PRETO, ROSA, ROSA, PRETO, BRANCO,     
  BRANCO, ROSA, ROSA, PRETO, PRETO, PRETO, PRETO, PRETO, PRETO, PRETO, ROSA, PRETO, PRETO, PRETO, PRETO, VERDE,
  BRANCO, BRANCO, BRANCO, BRANCO, BRANCO, BRANCO, BRANCO, BRANCO, BRANCO, BRANCO, BRANCO, BRANCO, BRANCO, BRANCO, BRANCO, BRANCO,
};

void initchar(){

}
void loadRandomMaze() {
  int r = random(1, 7);  // sorteia 1,2,3   (aumente se tiver mais)
  const CRGB* chosen;
if (r == 1) chosen = maze1; 
  else if (r == 2) chosen = maze2;
  else if (r == 3) chosen = maze3;
  else if (r == 4) chosen = maze4;
  else if (r == 5) chosen = maze5;
  else if (r == 6) chosen = maze6;
  Serial.println("Mane " + r);
  for (int y = 0; y < 16; y++) {
    for (int x = 0; x < 16; x++) {
      leds[ xy(x, y) ] = chosen[y * 16 + x];
    }
  }
  FastLED.show();
}
void startgame(){
  loadRandomMaze();
  initchar();
}
void setup() {
  Serial.begin(115200);
  FastLED.addLeds<NEOPIXEL, LED_PIN>(leds, NUM_LEDS);
  FastLED.clear();
  FastLED.show();
}

void loop() {
  // Nada — só exibe a imagem
  startgame();
}
